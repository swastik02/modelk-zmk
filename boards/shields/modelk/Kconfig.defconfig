## boards/shields/modelk/Kconfig.defconfig
```kconfig
if SHIELD_MODELK

# Name must be less than 16 characters long!
config ZMK_KEYBOARD_NAME
    default "modelk"

config SPI
    default y

endif
```

## config/west.yml
```yaml
manifest:
  remotes:
    - name: zmkfirmware
      url-base: https://github.com/zmkfirmware
    # - name: elpekenin
    #   url-base: https://github.com/elpekenin
    # - name: urob
    #   url-base: https://github.com/urob
  projects:
    - name: zmk
      remote: zmkfirmware
      revision: v0.3.0
      import: app/west.yml

    # - name: zmk-leader-key
    #   remote: urob
    #   revision: v0.2.1
  self:
    path: config
```
